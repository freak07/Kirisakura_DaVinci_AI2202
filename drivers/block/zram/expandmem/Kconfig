## drivers/block/zram/expandmem/Kconfig
```kconfig
# SPDX-License-Identifier: GPL-2.0
config EXPANDMEM
	tristate "Enable expand memory"
	depends on MEMCG && ZRAM
	help
	  With this feature, you can use the expanded memory
	  as the backend device in ZRAM.

config EXPANDMEM_DEBUG
	tristate "Enable expandmem debug"
	depends on EXPANDMEM
	help
	  This macro controls the debugging functions of expand memory.
```

## drivers/power/Kconfig
```kconfig
# SPDX-License-Identifier: GPL-2.0-only
source "drivers/power/reset/Kconfig"
source "drivers/power/supply/Kconfig"
# ASUS KTOP
source "drivers/power/ktop/Kconfig"
```

## drivers/power/ktop/Kconfig
```kconfig
#menu "ASUS POWER DEBUG"

config ASUS_POWER_DEBUG
	tristate "ASUS POWER DEBUG"
	default n

#endmenu
```
